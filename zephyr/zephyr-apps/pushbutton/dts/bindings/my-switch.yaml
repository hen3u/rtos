## zephyr/zephyr-apps/pushbutton/dts/bindings/my-switch.yaml
```yaml
description: Custom Input GPIO.

compatible: "my-switch"

properties:
  gpios:
    type: phandle-array
    required: true
    description: The input GPIO description.
```
